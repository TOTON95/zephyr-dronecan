## Kconfig
```kconfig
# zephyr-dronecan DroneCAN protocol stack configuration file

# Copyright (c) 2026 3DR, Inc.
# SPDX-License-Identifier: Apache-2.0

config DRONECAN
	bool "DroneCAN support"
	depends on CAN && DT_HAS_ZEPHYR_DRONECAN_ENABLED
	help
	 Enables the DroneCAN (libcanard) support.

if DRONECAN

module = DRONECAN
module-str = dronecan
source "subsys/logging/Kconfig.template.log_config"

menu "Protocol"

config DRONECAN_NODE_TABLE
	bool "Node discovery table"
	help
	  Track nodes seen on the bus, this is built from received NodeStatus msgs.

config DRONECAN_DNIA_SERVER
	bool "Dynamic Node ID allocation server"
	select DRONECAN_NODE_TABLE
	select DRONECAN_MSG_UAVCAN_PROTOCOL_DYNAMIC_NODE_ID_ALLOCATION
	help
	  Act as the DNIA allocator (like a flight controller).

config DRONECAN_DNIA_CLIENT
	bool "Dynamic Node ID allocation client"
	select HWINFO
	select DRONECAN_MSG_UAVCAN_PROTOCOL_DYNAMIC_NODE_ID_ALLOCATION
	help
	  Request a node ID from an allocator, using the hardware unique ID (like a peripheral).

config DRONECAN_SERVICE_GET_NODE_INFO
	bool "uavcan.protocol.GetNodeInfo service"
	select HWINFO
	help
	  Answer to GetNodeInfo requests with the node's status, software version (git),
	  hardware version (for e.g. USB PID), unique ID (the MCU serial number) and name.
	  Nodes that get their ID dynamically must support it.

config DRONECAN_NODE_NAME
	string "Node name"
	default "org.zephyrproject.dronecan"
	depends on DRONECAN_SERVICE_GET_NODE_INFO
	help
	  It needs to be a reversed domain name, for e.g. com.vendor.product. 1 to 80 characters out
	  of a-z, 0-9, dot, dash and underscore.

config DRONECAN_HW_PID
	hex "Product ID that gives the hardware revision"
	range 0 0xFFFF
	default 0
	depends on DRONECAN_SERVICE_GET_NODE_INFO
	help
	  The high byte is the major version and the low byte, the minor one. If available, with 0 it uses the
	  product ID of the USB device (CDC_ACM_SERIAL_PID or USB_DEVICE_PID). Without USB, it has to be set.

config DRONECAN_SERVICE_RESTART_NODE
	bool "uavcan.protocol.RestartNode service"
	select REBOOT
	help
	  Answer RestartNode requests. A node resets the MCU after
	  DRONECAN_RESTART_DELAY_MS. An application can refuse a restart,
	  for example while it is armed.

config DRONECAN_RESTART_DELAY_MS
	int "Delay between the answer and the restart (ms)"
	range 10 5000
	default 500
	depends on DRONECAN_SERVICE_RESTART_NODE
	help
	  Time the node keeps running after it answers a restart request, so that the
	  answer leaves the bus before the MCU resets.

# TODO
# config DRONECAN_SERVICE_PARAM
# 	bool "uavcan.protocol.param services (GetSet, ExecuteOpcode)"
# 
# config DRONECAN_PERIPHERAL
# 	bool "Peripheral node role"
# 	select DRONECAN_DNIA_CLIENT
# 	select DRONECAN_SERVICE_GET_NODE_INFO
# 	select DRONECAN_SERVICE_RESTART_NODE
# 	select DRONECAN_SERVICE_PARAM
# 	help
# 	  Node that gets its ID (0 initially) from a flight controller (DNIA) and answers the services.

endmenu # Protocol

menu "Resources"

config DRONECAN_RX_STACK_SIZE
	int "Rx thread stack size"
	default 4096
	help
	  About 4096 B was needed for ~60 message types enabled. Adjust accordingly.

config DRONECAN_HOUSEKEEPING_STACK_SIZE
	int "NodeStatus / housekeeping thread stack size"
	default 2048

config DRONECAN_TX_STACK_SIZE
	int "TX work queue stack size"
	default 1536
	help
	  Stack of the thread that sends queued frames. It also holds one batch of
	  DRONECAN_TX_DRAIN_MAX frames.

config DRONECAN_MAX_PUBLISHED_TYPES
	int "Max distinct message types published"
	default 8
	help
	  Number of message types the node can broadcast. Each needs a persistent
	  transfer ID.

config DRONECAN_THREAD_PRIORITY
	int "Thread priority"
	default 10 #TBD

config DRONECAN_INIT_PRIORITY
	int "Init priority"
	default 90
	help
	  Device init priority. Must be higher than CAN_INIT_PRIORITY (80 by default)
	  so the CAN controller is ready first.

config DRONECAN_NODE_STATUS_PERIOD_MS
	int "NodeStatus broadcast period (ms)"
	range 100 1000
	default 1000
	help
	  The DroneCAN specification allows 2 to 1000 ms. Other nodes treat this node
	  as offline after 3000 ms without a NodeStatus.

config DRONECAN_RX_MSGQ_SIZE
	int "RX frame queue depth"
	default 32

config DRONECAN_TX_TIMEOUT_MS
	int "CAN send timeout (ms)"
	default 10

config DRONECAN_TX_ACK_TIMEOUT_MS
	int "Time to wait for a frame to be acknowledged (ms)"
	default 100
	help
	  Without an ACK the controller retries forever. After this time the node
	  drops its queued frames until the bus answers again.

config DRONECAN_LOOPBACK_MODE
	bool "Start the CAN controller in loopback mode"
	help
	  For tests and self-test: the node receives its own frames. On a real
	  controller the frames do not reach the bus. Leave disabled in products.

config DRONECAN_NODE_TIMEOUT_MS
	int "Node considered stale after (ms)"
	default 3000
	depends on DRONECAN_NODE_TABLE

config DRONECAN_MAX_RX_PAYLOAD
	int "Largest transfer handed to subscribers (bytes)"
	default 512
	help
	  Larger transfers are not delivered. One buffer is kept per node.

config DRONECAN_MAX_SERVICE_RESPONSE
	int "Largest service response (bytes)"
	range 1 65535
	default 256
	help
	  Size of the buffer a service handler fills. One buffer is kept per node.

config DRONECAN_DNIA_TIMEOUT_MS
	int "Allocation follow-up timeout (ms)"
	default 500
	depends on DRONECAN_DNIA_SERVER

config DRONECAN_DNIA_CLIENT_STAGE_TIMEOUT_MS
	int "DNIA client: wait for the allocator's answer to a request (ms)"
	default 500
	depends on DRONECAN_DNIA_CLIENT

config DRONECAN_DNIA_MAX_GRANTS
	int "Node IDs remembered by the allocation server"
	default 16
	depends on DRONECAN_DNIA_SERVER
	help
	  A node that asks again with the same unique ID gets the same node ID.

config DRONECAN_TX_DRAIN_MAX
	int "Max frames drained per pass"
	default 16

# TODO
# config DRONECAN_MULTI_IFACE
# 	bool "Redundant CAN interfaces (CANARD_MULTI_IFACE)"

endmenu # Resources

menu "DSDL generation"

config DRONECAN_DSDL_UAVCAN
	def_bool y
	help
	  Always on: NodeStatus, which every node broadcasts, is in this namespace.

config DRONECAN_DSDL_DRONECAN
	bool "dronecan"
	default y

config DRONECAN_DSDL_ARDUPILOT
	bool "ardupilot"
	default y

endmenu # DSDL generation

rsource "Kconfig.messages"

menuconfig DRONECAN_SHELL
	bool "Shell commands"
	depends on SHELL
	help
	  All shell code lives in its own source file, the core never touches the shell

if DRONECAN_SHELL

config DRONECAN_SHELL_MONITOR
	bool "dc monitor"
	default y
	help
	  Displays the latest message sorted by message type

config DRONECAN_SHELL_SUBSCRIBE
	bool "dc subscribe"
	default y
	help
	  Suscribe to a message type and display obtained data

config DRONECAN_SHELL_PUBLISH
	bool "dc publish"
	default y
	help
	  Publish a message type to the CAN Bus

config DRONECAN_SHELL_MAX_PAYLOAD
	int "Max payload bytes for dc publish and dc subscribe"
	default 64
	range 8 512

config DRONECAN_SHELL_MAX_SUBSCRIPTIONS
	int "Max dc subscribe subscriptions"
	depends on DRONECAN_SHELL_SUBSCRIBE
	default 4

config DRONECAN_SHELL_MAX_PUBLISHERS
	int "Max messages dc publish repeats"
	depends on DRONECAN_SHELL_PUBLISH
	default 2

config DRONECAN_SHELL_MONITOR_TYPES
	int "Max message types dc monitor follows"
	depends on DRONECAN_SHELL_MONITOR
	default 16
	help
	  One subscription is used per message type.

config DRONECAN_SHELL_PERIPHERAL
	bool "dc peripheral"
	depends on DRONECAN_DNIA_CLIENT
	default y
	help
	  Ask an allocator for the node ID of an anonymous node

endif # DRONECAN_SHELL


endif # DRONECAN
```

## dts/bindings/zephyr,dronecan.yaml
```yaml
# Copyright (c) 2026 3DR, Inc.
# SPDX-License-Identifier: Apache-2.0

description: |
  DroneCAN (UAVCAN v0) node. Provisional compatible, see the module README.

compatible: "zephyr,dronecan"

include: base.yaml

properties:
  can-buses:
    type: phandles
    required: true
    description: |
      CAN controllers this node uses. One entry for now.

  node-id:
    type: int
    default: 0
    description: |
      Static node ID (1-127), or 0 for an anonymous node.

  mem-blocks:
    type: int
    default: 64
    description: |
      libcanard memory pool size in blocks.
```

## tests/core/testcase.yaml
```yaml
tests:
  dronecan.core:
    tags: dronecan
    harness: ztest
    platform_allow: native_sim
    integration_platforms:
      - native_sim
```

## tests/dnia/testcase.yaml
```yaml
tests:
  dronecan.dnia:
    tags: dronecan
    harness: ztest
    platform_allow: native_sim
    integration_platforms:
      - native_sim
```

## tests/node_info/testcase.yaml
```yaml
tests:
  dronecan.node_info:
    tags: dronecan
    harness: ztest
    platform_allow: native_sim
    integration_platforms:
      - native_sim
```

## tests/services/testcase.yaml
```yaml
tests:
  dronecan.services:
    tags: dronecan
    harness: ztest
    platform_allow: native_sim
    integration_platforms:
      - native_sim
```

## west.yml
```yaml
# Copyright (c) 2026 3DR, Inc.
# SPDX-License-Identifier: Apache-2.0


manifest:
  remotes: 
    - name: zephyrproject-rtos
      url-base: https://github.com/zephyrproject-rtos
  projects:
    - name: zephyr
      remote: zephyrproject-rtos
      revision: main
      clone-depth: 1
      import:
        name-allowlist:
          - cmsis_6
          - hal_stm32
    - name: DSDL
      url: https://github.com/dronecan/DSDL.git
      revision: b4653c7abc3c47cb31b16efa24ea755232774756
      path: lib/DSDL
    - name: dronecan_dsdlc
      url: https://github.com/dronecan/dronecan_dsdlc.git
      revision: 431170fa4bfe2212b516b8f33bdc796267907f1c
      path: lib/dronecan_dsdlc
```
